/*
 * Copyright (c) 2017, NVIDIA CORPORATION.  All rights reserved.
 *
 * This program is free software; you can redistribute it and/or modify
 * it under the terms of the GNU General Public License as published by
 * the Free Software Foundation; either version 2 of the License, or
 * (at your option) any later version.
 *
 * This program is distributed in the hope that it will be useful, but WITHOUT
 * ANY WARRANTY; without even the implied warranty of MERCHANTABILITY or
 * FITNESS FOR A PARTICULAR PURPOSE.  See the GNU General Public License for
 * more details.
 *
 * You should have received a copy of the GNU General Public License
 * along with this program.  If not, see <http://www.gnu.org/licenses/>.
 */
#include "tegra194-camera-imx334-a00.dtsi"
#include "dt-bindings/clock/tegra194-clock.h"

#define CAM0_RST    TEGRA194_MAIN_GPIO(Q, 5)
#define CAM0_PWDN   TEGRA194_MAIN_GPIO(P, 5)

/* camera control gpio definitions */

/ {
	i2c@c240000 {
		#address-cells = <1>;
		#size-cells = <0>;
		imx334_a@1a {
			/* Define any required hw resources needed by driver */
			/* ie. clocks, io pins, power sources */
			clocks = <&bpmp_clks TEGRA194_CLK_EXTPERIPH1>,
						<&bpmp_clks TEGRA194_CLK_EXTPERIPH1>;
			clock-names = "extperiph1", "pllp_grtba";
			mclk = "extperiph1";
			clock-frequency = <37125000>;
			reset-gpios = <&tegra_main_gpio CAM0_RST GPIO_ACTIVE_HIGH>;
			pwdn-gpios = <&tegra_main_gpio CAM0_PWDN GPIO_ACTIVE_HIGH>;
		};
	};
};